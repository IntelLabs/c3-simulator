## scripts/buildroot_config/simics_simple_riscv_defconfig
```kconfig
# Architecture
BR2_riscv=y
BR2_RISCV_64=y

# System
BR2_TARGET_GENERIC_GETTY_PORT="ttyS0"
BR2_SYSTEM_DHCP="eth0"

# Kernel
BR2_LINUX_KERNEL=y
BR2_LINUX_KERNEL_USE_ARCH_DEFAULT_CONFIG=y
BR2_LINUX_KERNEL_CUSTOM_VERSION_VALUE="6.5.8"
BR2_PACKAGE_HOST_LINUX_HEADERS_CUSTOM_6_5=y
BR2_LINUX_KERNEL_IMAGE=y

# Boot loader
BR2_TARGET_OPENSBI=y
BR2_TARGET_OPENSBI_PLAT="generic"

# Root file system
BR2_TARGET_ROOTFS_EXT2=y

# Host packages
BR2_PACKAGE_HOST_DTC=y

# For SSH
BR2_ROOTFS_OVERLAY="#C3_ROOT#/scripts/buildroot_rootfs_overlay/risc-v-simple"
BR2_PACKAGE_OPENSSH=y
```
